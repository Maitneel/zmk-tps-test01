## boards/shields/zmk_tpc_test01/Kconfig.defconfig
```kconfig
if SHIELD_ZMK_TPC_TEST01_LEFT

config ZMK_KEYBOARD_NAME
    default "zmk-tpc-test01"

config ZMK_SPLIT_ROLE_CENTRAL
    default y

endif # SHIELD_ZMK_TPC_TEST01_LEFT

if SHIELD_ZMK_TPC_TEST01_LEFT || SHIELD_ZMK_TPC_TEST01_RIGHT

config ZMK_SPLIT
    default y

config ZMK_BLE
    default y

endif # SHIELD_ZMK_TPC_TEST01_LEFT || SHIELD_ZMK_TPC_TEST01_RIGHT
```

## boards/shields/zmk_tpc_test01/Kconfig.shield
```kconfig
config SHIELD_ZMK_TPC_TEST01_LEFT
    def_bool $(shields_list_contains,zmk_tpc_test01_left)

config SHIELD_ZMK_TPC_TEST01_RIGHT
    def_bool $(shields_list_contains,zmk_tpc_test01_right)
```

## boards/shields/zmk_tps_test01/Kconfig.defconfig
```kconfig
if SHIELD_ZMK_TPS_TEST01_LEFT

config ZMK_KEYBOARD_NAME
    default "zmk-tps-test01"

config ZMK_SPLIT_ROLE_CENTRAL
    default y

endif # SHIELD_ZMK_TPS_TEST01_LEFT

if SHIELD_ZMK_TPS_TEST01_LEFT || SHIELD_ZMK_TPS_TEST01_RIGHT

config ZMK_SPLIT
    default y

config ZMK_BLE
    default y

endif # SHIELD_ZMK_TPS_TEST01_LEFT || SHIELD_ZMK_TPS_TEST01_RIGHT
```

## boards/shields/zmk_tps_test01/Kconfig.shield
```kconfig
config SHIELD_ZMK_TPS_TEST01_LEFT
    def_bool $(shields_list_contains,zmk_tps_test01_left)

config SHIELD_ZMK_TPS_TEST01_RIGHT
    def_bool $(shields_list_contains,zmk_tps_test01_right)
```
